#include <LedControl.h>
#include <ESP8266WiFi.h>
#include <NTPClient.h>
#include <WiFiUdp.h>
#include <time.h>

const char *ssid = "SSID";
const char *password = "PASS";

// Define NTP Client to get time
WiFiUDP ntpUDP;
NTPClient timeClient(ntpUDP, "pool.ntp.org");

//Week Days
String weekDays[7] = {"Sunday", "Monday", "Tuesday", "Wednesday", "Thursday", "Friday", "Saturday"};

unsigned long time1 = 0;
int MaxDevice = 4;
int Xpixel = 5;
int OnOff = 1;
int MatrixX, MatrixY;
LedControl lc = LedControl(13, 14, 2, MaxDevice);

byte Font[][8] = {
  0x00, 0x00, 0x00, 0x00, 0x00, 0x00, 0x00, 0x00, //32 SPACE
  0x08, 0x00, 0x08, 0x08, 0x08, 0x08, 0x08, 0x08, //33 !
  0x00, 0x00, 0x00, 0x00, 0x00, 0x14, 0x14, 0x14, //34 "
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  0x00, 0x00, 0x00, 0x0D, 0x17, 0x00, 0x00, 0x00, //126 ~
};
byte smallNumber[][8] = {
  0x07, 0x05, 0x05, 0x05, 0x07, 0x00, 0x00, 0x00, //0
  0x02, 0x02, 0x02, 0x02, 0x02, 0x00, 0x00, 0x00, //1
  0x07, 0x01, 0x07, 0x04, 0x07, 0x00, 0x00, 0x00, //2
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  0x07, 0x04, 0x07, 0x05, 0x07, 0x00, 0x00, 0x00, //9
};
byte Buffer_display[8][4];
void setup() {
  // Initialize Serial Monitor
  Serial.begin(115200);
  WiFi.begin(ssid, password);
  while (WiFi.status() != WL_CONNECTED)
  {
    delay(500);
    Serial.print(".");
  }

  // Initialize a NTPClient to get time
  timeClient.begin();
  // Set offset time in seconds to adjust for your timezone, for example:
  // GMT +1 = 3600
  // GMT +8 = 28800
  // GMT -1 = -3600
  // GMT 0 = 0
  timeClient.setTimeOffset(7 * 60 * 60);
  for (int i = 0; i < MaxDevice; i ++) {
    lc.shutdown(i, false);
    lc.setIntensity(i, 1);
    lc.clearDisplay(i);
  }
}
void Matrix_setpx(int x, int y, char color)
{
  if (x > 31 || y > 7 || x < 0 || y < 0)return;
  if (color)Buffer_display[y][x / 8] |= (0x1 << (x % 8)); //sáng led
  else Buffer_display[y][x / 8] &= ~(0x1 << (x % 8)); //tắt led
  for (int i = 0; i < 8; i++) {
    lc.setRow(x / 8, i, Buffer_display[i][x / 8]);
  }
}
void Matrix_guikitu(unsigned char txt)
{
  int x, y;
  for (y = MatrixY; y < 8 + MatrixY; y++) // số pixel sẽ load ở trục y
  {
    for (x = MatrixX; x < Xpixel + MatrixX; x++) // số pixel sẽ load ở trục X
    {
      if ( (Font[txt - 32][y - MatrixY] & (0x1 << (x - MatrixX)))  != 0)Matrix_setpx(x, y, 1);
      else Matrix_setpx(x, y, 0);
    }
  }
  MatrixX += 5; //sau khi in xong thi tang con tro vi tri len
} 
void Matrix_guikitunho(unsigned char txt)
{
  int x, y;
  for (y = MatrixY; y < 8 + MatrixY; y++) // số pixel sẽ load ở trục y
  {
    for (x = MatrixX; x < Xpixel + MatrixX; x++) // số pixel sẽ load ở trục X
    {
      if ( (smallNumber[txt - 48][y - MatrixY] & (0x1 << (x - MatrixX)))  != 0)Matrix_setpx(x, y, 1);
      else Matrix_setpx(x, y, 0);
    }
  }
  MatrixX += 4; //sau khi in xong thi tang con tro vi tri len
}
void Matrix_guichuoi(const char *s)
{
  while (*s)
  {
    Matrix_guikitu(*s);
    s++;
  }
}
void Matrix_chonvitri(int x, int y)
{
  MatrixX = x;
  MatrixY = y;
}
void loop() {
  Matrix_chonvitri(0, 0);
  timeClient.update();
  String currentHour = String(timeClient.getHours());
  Serial.print("Hour: ");
  Serial.println(currentHour);
  if (currentHour.length() < 2) {
    currentHour = "0" + currentHour;
  }

  String currentMinute = String(timeClient.getMinutes());
  Serial.print("Minutes: ");
  Serial.println(currentMinute);
  if (currentMinute.length() < 2) {
    currentMinute = "0" + currentMinute;
  }

  String currentSecond = String(timeClient.getSeconds());
  Serial.print("Seconds: ");
  Serial.println(currentSecond);
  if ( currentSecond.length() < 2) {
    currentSecond = "0" + currentSecond;
  }
  if (currentSecond.length() < 2) {
    currentSecond = "0" + currentSecond;
  }
  for (int i = 0; i < currentHour.length(); i++) {
    Xpixel = 5;
    if (currentHour.charAt(0) == '1') {
      if (i == 0) {
        Xpixel = 4;
      }
    }
    if (currentHour.charAt(1) == '4') {
      if (i == 1) {
        Xpixel = 6;
      }
    }
    Matrix_guikitu(currentHour.charAt(i));
    MatrixX -= 1;
    if (currentHour.charAt(1) == '1') {
      if (i == 1) {
        MatrixX -= 1;
      }
    }
    if (currentHour.charAt(1) == '4') {
      if (i == 1) {
        MatrixX += 1;
      }
    }
    if (currentHour.charAt(0) != '1') {
      if (i == 0) {
        MatrixX += 1;
      }
    }
  }
  if ((unsigned long) (millis() - time1) > 1000) {
    if (OnOff) {
      Matrix_setpx(MatrixX + 1, 2, OnOff);
      Matrix_setpx(MatrixX + 1, 5, OnOff);
      OnOff = 0;
    }
    else {
      Matrix_setpx(MatrixX + 1, 2, OnOff);
      Matrix_setpx(MatrixX + 1, 5, OnOff);
      OnOff = 1;
    }
    time1 = millis();
  }

  MatrixX += 3;
  for (int i = 0; i < currentMinute.length(); i++) {
     Xpixel = 5;
    if (currentMinute.charAt(0) == '1') {
      if (i == 0) {
        Xpixel = 4;
      }
      else if (i == 1) {
        MatrixX -= 1;
      }
    }
     if(currentMinute.charAt(1) == '1'){
      if (i == 1){
        Xpixel = 4;
      }
    }
    if (currentMinute.charAt(0) == '4') {
      if (i == 0) {
        Xpixel = 6;
      }
    }
     if (currentMinute.charAt(1) == '4') {
      if (i == 1) {
        Xpixel = 6;
      }
    }
    Matrix_guikitu(currentMinute.charAt(i));
    if (currentMinute.charAt(0) == '4') {
      if (i == 0) {
        MatrixX += 1;
      }
    }
    if (currentMinute.charAt(0) == '0') {
      if (i == 0) {
        MatrixX += 1;
      }
    }
    if (currentMinute.charAt(1) == '4') {
      if (i == 1) {
        MatrixX += 1;
      }
    }
    if(currentMinute.charAt(1) == '1'){
      if (i == 1){
        MatrixX -= 1;
      }
    }
  }
  for (int i = 0; i < currentSecond.length(); i++) {
    Xpixel = 4;
    if (currentSecond.charAt(0) == '4') {
      Xpixel = 4;
    }
    if (currentSecond.charAt(0) == '1') {
      if (i == 0) {
        Xpixel = 3;
        MatrixX -= 1;
      }
      else {
        Xpixel = 5;
      }
    }
    if (currentSecond.charAt(1) == '1') {
      if (i == 1) {
        MatrixX -= 1;
      }
    }
    Matrix_guikitunho(currentSecond.charAt(i));
    if (currentSecond.charAt(0) == '1') {
      MatrixX -= 1;
    }
  }
}

void Debug() {
  Matrix_chonvitri(0, 0);
  for (int i = 0; i < 10; i++) {
    char Number[10] = {'0', '1', '2', '3', '4', '5', '6', '7', '8', '9'};
    if (i % 4 == 0) {
      Matrix_chonvitri(0, 0);
      Matrix_guichuoi("      ");
      Matrix_chonvitri(0, 0);
    }
    if (Number[i] == '2') {
      MatrixX -= 1;
    }
    if (Number[i] == '5') {
      MatrixX += 1;
    }
    Matrix_guikitu(Number[i]);
    delay(1000);
  }
}
